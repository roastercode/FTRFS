## Kconfig
```kconfig
# SPDX-License-Identifier: GPL-2.0-only
#
# FTRFS filesystem configuration
#

config FTRFS_FS
	tristate "FTRFS fault-tolerant radiation-robust filesystem"
	depends on BLOCK
	select CRC32
	select REED_SOLOMON
	select REED_SOLOMON_ENC8
	select REED_SOLOMON_DEC8
	help
	  FTRFS is a POSIX-compatible filesystem designed for dependable
	  storage in radiation-intensive environments. It provides:

	    - CRC32 checksumming per block and per inode
	    - Reed-Solomon forward error correction (FEC) via lib/reed_solomon
	    - Radiation Event Journal: persistent per-correction log in superblock

	  RS(255,239) over GF(2^8) corrects up to 8 symbol errors per 239-byte
	  subblock in place, on a single device, without external redundancy.
	  This addresses silent bit flips caused by single-event upsets (SEU)
	  in MRAM or NOR flash on embedded systems in radiation environments.

	  Target: embedded Linux on nanosatellites and CubeSats (MOVE-II,
	  TU Munich), robotics in nuclear/industrial environments, space HPC.
	  DO-178C / ECSS-E-ST-40C / IEC 61508 certification is an explicit
	  design constraint: the codebase targets under 5000 auditable lines.

	  Originally described in:
	  Fuchs, Langer, Trinitis — ARCS 2015, TU Munich / MOVE-II CubeSat.
	  https://www.cfuchs.net/chris/publication-list/ARCS2015/FTRFS.pdf

	  To compile as a module, choose M. The module will be called ftrfs.

	  If unsure, say N.

config FTRFS_FS_XATTR
	bool "FTRFS extended attributes"
	depends on FTRFS_FS
	help
	  Extended attributes are name:value pairs associated with inodes
	  by mapping arbitrary names to binary values. They are required
	  for SELinux, POSIX ACLs, and other security frameworks that
	  store security labels or capabilities on files and directories.
	  FTRFS stores xattrs in a dedicated area of the inode block to
	  preserve the auditable line count required by DO-178C/ECSS-E-ST-40C.

	  If you are not using SELinux or POSIX ACLs, say N.

config FTRFS_FS_SECURITY
	bool "FTRFS Security Labels"
	depends on FTRFS_FS_XATTR
	help
	  Security labels support alternative access control models
	  implemented by security modules like SELinux. This option
	  enables an extended attribute handler for file security labels
	  in the ftrfs filesystem, so that it will work with SELinux.

	  If you are not using a security module that requires using
	  extended attributes for file security labels, say N.
```
